## conf/bblayers.conf
```bitbake
# POKY_BBLAYERS_CONF_VERSION is increased each time build/conf/bblayers.conf
# changes incompatibly
POKY_BBLAYERS_CONF_VERSION = "2"

BBPATH = "${TOPDIR}"
BBFILES ?= ""

BBLAYERS ?= " \
  /home/ubunto/dunfell/meta \
  /home/ubunto/dunfell/meta-poky \
  /home/ubunto/dunfell/meta-yocto-bsp \
  /home/ubunto/dunfell/meta-openembedded/meta-oe \
  /home/ubunto/dunfell/meta-openembedded/meta-multimedia \
  /home/ubunto/dunfell/meta-tensorflow-lite \
  /home/ubunto/dunfell/meta-openembedded/meta-networking \
  /home/ubunto/dunfell/meta-openembedded/meta-python \
  /home/ubunto/dunfell/meta-raspberrypi \
  /home/ubunto/dunfell/meta-programa1 \
  "
```
